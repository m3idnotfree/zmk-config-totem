/ {
    keymap {
        campatible = "zmk,keymap";
        
        linux_mouse {
            bindings = <
//╭──────╮ ╭─────────────┬─────────────┬─────────────┬─────────────┬─────────────╮ ╭──────╮ ╭─────────────┬─────────────┬─────────────┬─────────────┬─────────────╮ ╭──────╮
    X_LT     ___           ___           &kp F         XXX           ___             X_MT                                 _MOUSE_TOP_                                 X_RT
//├──────┤ ├─────────────┼─────────────┼─────────────┼─────────────┼─────────────┤ ├──────┤ ├─────────────┼─────────────┼─────────────┼─────────────┼─────────────┤ ├──────┤
    X_LM     &kp UP        &kp LS(RET)   ___           ___           &kp I           X_MM                                 _MOUSE_MID_                                 X_RM
//├──────┤ ├─────────────┼─────────────┼─────────────┼─────────────┼─────────────┤ ├──────┤ ├─────────────┼─────────────┼─────────────┼─────────────┼─────────────┤ ├──────┤
  &kp LEFT   &kp DOWN      &kp RIGHT     ___           ___           ___             X_MB                                 _MOUSE_BOT_                               &kp LC(T)
//├──────┤ ╰─────────────┼─────────────┴─────────────┼─────────────┼─────────────┤ ├──────┤ ├─────────────┼─────────────┼─────────────┴───────────────────────────╯ ├──────┤
    X_LH                                               &kp C_VOL_DN  &kp C_VOL_UP    X_MH                                 _MOUSE_THU_
//╰──────╯                                           ╰─────────────┴─────────────╯ ╰──────╯ ╰─────────────┴─────────────╯                                           ╰──────╯
            >;
        };
  };
};

