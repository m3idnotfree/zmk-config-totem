#define CONFIG_WIRELESS
#define X_LB    &tog QWE
#define X_RB    &tog NAV

#define X_LH    &tog_hng
#define X_RH    &ht_zj_mouse ZELLIJ MOUSE

#define ZMK_BASE_LAYER(name, LT, RT, LM, RM, LB, RB, LH, RH)                   \
    ZMK_LAYER(                                                                 \
        name,                                                                  \
                 LT RT                                                         \
                 LM RM                                                         \
            X_LB LB RB X_RB                                                    \
            X_LH LH RH X_RH                                                    \
    )

#define ZMK_TOTEM_LAYER(name, LT, RT, LM, RM, LB, RB, LH, RH)                  \
    ZMK_LAYER(                                                                 \
        name,                                                                  \
                 LT RT                                                         \
                 LM RM                                                         \
                 LB RB                                                         \
                 LH RH                                                         \
    )


#include "zmk-helpers/key-labels/totem.h"
#include "base.keymap"
