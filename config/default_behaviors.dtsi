/* sticky-key config */
&sk {  
    release-after-ms = <900>;  // release after 0.6s
    quick-release;             // no double capitalization when rolling keys
};
/* sticky-layer config */
&sl {  
    ignore-modifiers;          // allow chording sticky mods & layers
};
/* layer-tap config */
&lt {  
    flavor = "balanced";
    tapping-term-ms = <200>;
    quick-tap-ms = <QUICK_TAP_MS>;
};

/* long-tap action on hold, short-tap action on all interrupts */
#define MT_CORE                       \
    flavor = "tap-preferred";         \
    tapping-term-ms = <220>;          \
    quick-tap-ms = <220>;             \
    hold-trigger-key-positions = <0>;

&mt { MT_CORE };

/* mods deactivate caps-word, requires PR #1451 */
&caps_word {  
    /delete-property/ ignore-modifiers;
};

// Sticky layer + sticky shift (workaround for issue #1421)
// ZMK_STICKY_KEY(sls,
//     release-after-ms = <1000>;
//     bindings = <&uc_shift>;
//     ignore-modifiers;
// )
